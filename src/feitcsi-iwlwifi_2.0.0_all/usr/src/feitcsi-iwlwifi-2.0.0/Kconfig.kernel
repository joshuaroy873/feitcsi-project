## src/feitcsi-iwlwifi_2.0.0_all/usr/src/feitcsi-iwlwifi-2.0.0/Kconfig.versions
```kconfig
config KERNEL_6_7
    def_bool y
config KERNEL_6_8
    def_bool y
config KERNEL_6_9
    def_bool y
config KERNEL_6_10
    def_bool y
config KERNEL_6_11
    def_bool y
config KERNEL_6_12
    def_bool y
config KERNEL_6_13
    def_bool y
config KERNEL_6_14
    def_bool y
config KERNEL_6_15
    def_bool y
config KERNEL_6_16
    def_bool y
config KERNEL_6_17
    def_bool y
config KERNEL_6_18
    def_bool y
config KERNEL_6_19
    def_bool y
config KERNEL_6_20
    def_bool y
config KERNEL_6_21
    def_bool y
config KERNEL_6_22
    def_bool y
config KERNEL_6_23
    def_bool y
config KERNEL_6_24
    def_bool y
config KERNEL_6_25
    def_bool y
config KERNEL_6_26
    def_bool y
config KERNEL_6_27
    def_bool y
config KERNEL_6_28
    def_bool y
config KERNEL_6_29
    def_bool y
config KERNEL_6_30
    def_bool y
config KERNEL_6_31
    def_bool y
config KERNEL_6_32
    def_bool y
config KERNEL_6_33
    def_bool y
config KERNEL_6_34
    def_bool y
config KERNEL_6_35
    def_bool y
config KERNEL_6_36
    def_bool y
config KERNEL_6_37
    def_bool y
config KERNEL_6_38
    def_bool y
config KERNEL_6_39
    def_bool y
config KERNEL_6_40
    def_bool y
config KERNEL_6_41
    def_bool y
config KERNEL_6_42
    def_bool y
config KERNEL_6_43
    def_bool y
config KERNEL_6_44
    def_bool y
config KERNEL_6_45
    def_bool y
config KERNEL_6_46
    def_bool y
config KERNEL_6_47
    def_bool y
config KERNEL_6_48
    def_bool y
config KERNEL_6_49
    def_bool y
config KERNEL_6_50
    def_bool y
config KERNEL_6_51
    def_bool y
config KERNEL_6_52
    def_bool y
config KERNEL_6_53
    def_bool y
config KERNEL_6_54
    def_bool y
config KERNEL_6_55
    def_bool y
config KERNEL_6_56
    def_bool y
config KERNEL_6_57
    def_bool y
config KERNEL_6_58
    def_bool y
config KERNEL_6_59
    def_bool y
config KERNEL_6_60
    def_bool y
config KERNEL_6_61
    def_bool y
config KERNEL_6_62
    def_bool y
config KERNEL_6_63
    def_bool y
config KERNEL_6_64
    def_bool y
config KERNEL_6_65
    def_bool y
config KERNEL_6_66
    def_bool y
config KERNEL_6_67
    def_bool y
config KERNEL_6_68
    def_bool y
config KERNEL_6_69
    def_bool y
config KERNEL_6_70
    def_bool y
config KERNEL_6_71
    def_bool y
config KERNEL_6_72
    def_bool y
config KERNEL_6_73
    def_bool y
config KERNEL_6_74
    def_bool y
config KERNEL_6_75
    def_bool y
config KERNEL_6_76
    def_bool y
config KERNEL_6_77
    def_bool y
config KERNEL_6_78
    def_bool y
config KERNEL_6_79
    def_bool y
config KERNEL_6_80
    def_bool y
config KERNEL_6_81
    def_bool y
config KERNEL_6_82
    def_bool y
config KERNEL_6_83
    def_bool y
config KERNEL_6_84
    def_bool y
config KERNEL_6_85
    def_bool y
config KERNEL_6_86
    def_bool y
config KERNEL_6_87
    def_bool y
config KERNEL_6_88
    def_bool y
config KERNEL_6_89
    def_bool y
config KERNEL_6_90
    def_bool y
config KERNEL_6_91
    def_bool y
config KERNEL_6_92
    def_bool y
config KERNEL_6_93
    def_bool y
config KERNEL_6_94
    def_bool y
config KERNEL_6_95
    def_bool y
config KERNEL_6_96
    def_bool y
config KERNEL_6_97
    def_bool y
config KERNEL_6_98
    def_bool y
config KERNEL_6_99
    def_bool y
```
